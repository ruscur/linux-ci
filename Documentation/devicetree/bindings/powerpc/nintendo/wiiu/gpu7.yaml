## Documentation/devicetree/bindings/powerpc/nintendo/wiiu/gpu7.yaml
```yaml
# SPDX-License-Identifier: (GPL-2.0-only OR BSD-2-Clause)
%YAML 1.2
---
$id: http://devicetree.org/schemas/powerpc/nintendo/wiiu/gpu7.yaml#
$schema: http://devicetree.org/meta-schemas/core.yaml#

title: Nintendo Wii U Latte "GPU7" graphics processor

maintainers:
  - Ash Logan <ash@heyquark.com>
  - Emmanuel Gil Peyrot <linkmauve@linkmauve.fr>

description: |
  GPU7 graphics processor, also known as "GX2", found in the Latte multifunction chip of the
  Nintendo Wii U.

properties:
  compatible:
    const: nintendo,latte-gpu7

  reg:
    maxItems: 1

  interrupts:
    maxItems: 1

required:
  - compatible
  - reg
  - interrupts

additionalProperties: false

examples:
  - |
    gpu@c200000 {
        compatible = "nintendo,latte-gpu7";
        reg = <0x0c200000 0x80000>;
        interrupts = <2>;
        interrupt-parent = <&espresso_pic>;
    };
...
```

## Documentation/devicetree/bindings/powerpc/nintendo/wiiu/latte-dsp.yaml
```yaml
# SPDX-License-Identifier: (GPL-2.0-only OR BSD-2-Clause)
%YAML 1.2
---
$id: http://devicetree.org/schemas/powerpc/nintendo/wiiu/latte-dsp.yaml#
$schema: http://devicetree.org/meta-schemas/core.yaml#

title: Nintendo Wii U Latte DSP

maintainers:
  - Ash Logan <ash@heyquark.com>
  - Emmanuel Gil Peyrot <linkmauve@linkmauve.fr>

description: |
  Nintendo Wii U digital signal processor, as found in the Latte chip.

properties:
  compatible:
    const: nintendo,latte-dsp

  reg:
    maxItems: 1

required:
  - compatible
  - reg

additionalProperties: false

examples:
  - |
    dsp@c005000 {
        compatible = "nintendo,latte-dsp";
        reg = <0x0c005000 0x200>;
    };
...
```

## Documentation/devicetree/bindings/powerpc/nintendo/wiiu/latte-pic.yaml
```yaml
# SPDX-License-Identifier: (GPL-2.0-only OR BSD-2-Clause)
%YAML 1.2
---
$id: http://devicetree.org/schemas/powerpc/nintendo/wiiu/latte-pic.yaml#
$schema: http://devicetree.org/meta-schemas/core.yaml#

title: Nintendo Wii U Latte interrupt controller

maintainers:
  - Ash Logan <ash@heyquark.com>
  - Emmanuel Gil Peyrot <linkmauve@linkmauve.fr>

description: |
  Interrupt controller found on the Nintendo Wii U for the "Latte" devices.

allOf:
  - $ref: "/schemas/interrupt-controller.yaml#"

properties:
  compatible:
    const: nintendo,latte-pic

  '#interrupt-cells':
    # Interrupt numbers 0-64 in one cell.
    const: 1

  interrupt-controller: true

  reg:
    maxItems: 1

  interrupts:
    items:
      - description: Cascade interrupt for Espresso PIC

required:
  - compatible
  - '#interrupt-cells'
  - interrupt-controller
  - reg

additionalProperties: false

examples:
  - |
    interrupt-controller@d800440 {
        compatible = "nintendo,latte-pic";
        #interrupt-cells = <1>;
        interrupt-controller;
        reg = <0x0d800440 0x30>;

        interrupt-parent = <&espresso_pic>;
        interrupts = <24>;
    };
...
```

## Documentation/devicetree/bindings/powerpc/nintendo/wiiu/latte-sdhci.yaml
```yaml
# SPDX-License-Identifier: (GPL-2.0-only OR BSD-2-Clause)
%YAML 1.2
---
$id: http://devicetree.org/schemas/powerpc/nintendo/wiiu/latte-sdhci.yaml#
$schema: http://devicetree.org/meta-schemas/core.yaml#

title: Nintendo Wii U Latte SD Host controller

maintainers:
  - Ash Logan <ash@heyquark.com>
  - Emmanuel Gil Peyrot <linkmauve@linkmauve.fr>

description: |
  SDHCI hosts found on the Nintendo Wii U's Latte SoC for SD cards and SDIO devices.

allOf:
  - $ref: "/schemas/mmc/mmc-controller.yaml#"

properties:
  compatible:
    items:
      - const: nintendo,latte-sdhci
      - const: sdhci

  reg:
    maxItems: 1

  interrupts:
    maxItems: 1

required:
  - compatible
  - reg
  - interrupts

additionalProperties: false

examples:
  - |
    mmc@d070000 {
        compatible = "nintendo,latte-sdhci", "sdhci";
        reg = <0x0d070000 0x200>;
        interrupts = <7>;
        interrupt-parent = <&latte_pic>;
    };
...
```

## Documentation/devicetree/bindings/soc/fsl/cpm_qe/fsl,qmc.yaml
```yaml
# SPDX-License-Identifier: (GPL-2.0-only OR BSD-2-Clause)
%YAML 1.2
---
$id: http://devicetree.org/schemas/soc/fsl/cpm_qe/fsl,qmc.yaml#
$schema: http://devicetree.org/meta-schemas/core.yaml#

title: PowerQUICC CPM QUICC Multichannel Controller (QMC)

maintainers:
  - Herve Codina <herve.codina@bootlin.com>

description: |
  The QMC (QUICC Multichannel Controller) emulates up to 64 channels within
  one serial controller using the same TDM physical interface routed from
  TSA.

properties:
  compatible:
    items:
      - enum:
          - fsl,mpc885-scc-qmc
          - fsl,mpc866-scc-qmc
      - const: fsl,cpm1-scc-qmc

  reg:
    items:
      - description: SCC (Serial communication controller) register base
      - description: SCC parameter ram base
      - description: Dual port ram base

  reg-names:
    items:
      - const: scc_regs
      - const: scc_pram
      - const: dpram

  interrupts:
    description: SCC interrupt line in the CPM interrupt controller

  fsl,cpm-command:
    $ref: /schemas/types.yaml#/definitions/uint32
    description: Cf. soc/fsl/cpm_qe/cpm.txt

  tsa:
    $ref: /schemas/types.yaml#/definitions/phandle
    description: phandle to the TSA

  tsa-cell-id:
    enum: [1, 2, 3]
    description: |
      TSA cell ID (dt-bindings/soc/fsl-tsa.h defines these values)
       - 1: SCC2
       - 2: SCC3
       - 3: SCC4

  '#address-cells':
    const: 1

  '#size-cells':
    const: 0

  '#chan-cells':
    const: 1

patternProperties:
  "^channel@([0-9]|[1-5][0-9]|6[0-3])$":
    description:
      A channel managed by this controller
    type: object

    properties:
      reg:
        minimum: 0
        maximum: 63
        description:
          The channel number

      fsl,mode:
        $ref: /schemas/types.yaml#/definitions/string
        enum: [transparent, hdlc]
        default: transparent
        description: Operational mode

      fsl,reverse-data:
        $ref: /schemas/types.yaml#/definitions/flag
        description:
          The bit order as seen on the channels is reversed,
          transmitting/receiving the MSB of each octet first.
          This flag is used only in 'transparent' mode.

      tx-ts-mask:
        $ref: /schemas/types.yaml#/definitions/uint64
        description:
          Channel assigned Tx time-slots within the Tx time-slots routed
          by the TSA to this cell.

      rx-ts-mask:
        $ref: /schemas/types.yaml#/definitions/uint64
        description:
          Channel assigned Rx time-slots within the Rx time-slots routed
          by the TSA to this cell.

    required:
      - reg
      - tx-ts-mask
      - rx-ts-mask

required:
  - compatible
  - reg
  - reg-names
  - interrupts
  - tsa
  - tsa-cell-id
  - '#address-cells'
  - '#size-cells'
  - '#chan-cells'

additionalProperties: false

examples:
  - |
    #include <dt-bindings/soc/fsl-tsa.h>

    scc_qmc@a60 {
        compatible = "fsl,mpc885-scc-qmc", "fsl,cpm1-scc-qmc";
        reg = <0xa60 0x20>,
              <0x3f00 0xc0>,
              <0x2000 0x1000>;
        reg-names = "scc_regs", "scc_pram", "dpram";
        interrupts = <27>;
        interrupt-parent = <&CPM_PIC>;
        fsl,cpm-command = <0xc0>;

        #address-cells = <1>;
        #size-cells = <0>;
        #chan-cells = <1>;

        tsa = <&tsa>;
        tsa-cell-id = <FSL_CPM_TSA_SCC4>;

        channel@16 {
            /* Ch16 : First 4 even TS from all routed from TSA */
            reg = <16>;
            fsl,mode = "transparent";
            fsl,reverse-data;
            tx-ts-mask = <0x00000000 0x000000AA>;
            rx-ts-mask = <0x00000000 0x000000AA>;
        };

        channel@17 {
            /* Ch17 : First 4 odd TS from all routed from TSA */
            reg = <17>;
            fsl,mode = "transparent";
            fsl,reverse-data;
            tx-ts-mask = <0x00000000 0x00000055>;
            rx-ts-mask = <0x00000000 0x00000055>;
        };

        channel@19 {
            /* Ch19 : 8 TS (TS 8..15) from all routed from TSA */
            reg = <19>;
            fsl,mode = "hdlc";
            tx-ts-mask = <0x00000000 0x0000FF00>;
            rx-ts-mask = <0x00000000 0x0000FF00>;
        };
    };
```

## fs/fwsecurityfs/Kconfig
```kconfig
# SPDX-License-Identifier: GPL-2.0-only
#
# Copyright (C) 2022 IBM Corporation
# Author: Nayna Jain <nayna@linux.ibm.com>
#

config FWSECURITYFS
	bool "Enable the fwsecurityfs filesystem"
	help
	  This will build fwsecurityfs filesystem which should be mounted
	  on /sys/firmware/security. This filesystem can be used by
	  platform to expose firmware-managed variables.

	  If you are unsure how to answer this question, answer N.
```
